## os/Config.in
```kconfig
menu "NEPTRON packages"
	source "$BR2_EXTERNAL_NEPTRON_PATH/package/libretro-fceumm/Config.in"
	source "$BR2_EXTERNAL_NEPTRON_PATH/package/libretro-genesis-plus-gx/Config.in"
	source "$BR2_EXTERNAL_NEPTRON_PATH/package/libretro-snes9x/Config.in"
	source "$BR2_EXTERNAL_NEPTRON_PATH/package/neptron/Config.in"
	source "$BR2_EXTERNAL_NEPTRON_PATH/package/neptron-capture/Config.in"
	source "$BR2_EXTERNAL_NEPTRON_PATH/package/neptron-launch/Config.in"
	source "$BR2_EXTERNAL_NEPTRON_PATH/package/neptron-vkms-probe/Config.in"
	source "$BR2_EXTERNAL_NEPTRON_PATH/package/neptronctl/Config.in"
endmenu
```

## os/configs/neptron_pc_x86_64_defconfig
```kconfig
BR2_x86_64=y
BR2_CCACHE=y
BR2_GLOBAL_PATCH_DIR="$(BR2_EXTERNAL_NEPTRON_PATH)/patches"
BR2_DOWNLOAD_FORCE_CHECK_HASHES=y
BR2_TOOLCHAIN_BUILDROOT_GLIBC=y
BR2_TOOLCHAIN_BUILDROOT_CXX=y
BR2_KERNEL_HEADERS_AS_KERNEL=y
BR2_PACKAGE_HOST_LINUX_HEADERS_CUSTOM_6_18=y
BR2_TARGET_GENERIC_HOSTNAME="neptron"
BR2_TARGET_GENERIC_ISSUE="NEPTRON"
BR2_INIT_BUSYBOX=y
BR2_ROOTFS_DEVICE_CREATION_DYNAMIC_MDEV=y
# BR2_TARGET_GENERIC_GETTY is not set
# BR2_TARGET_GENERIC_REMOUNT_ROOTFS_RW is not set
BR2_PACKAGE_BUSYBOX_CONFIG_FRAGMENT_FILES="$(BR2_EXTERNAL_NEPTRON_PATH)/board/common/busybox.config $(BR2_EXTERNAL_NEPTRON_PATH)/board/pc/busybox.config"
BR2_ROOTFS_OVERLAY="$(BR2_EXTERNAL_NEPTRON_PATH)/board/common/rootfs-overlay $(BR2_EXTERNAL_NEPTRON_PATH)/board/pc/rootfs-overlay"
BR2_ROOTFS_POST_BUILD_SCRIPT="$(BR2_EXTERNAL_NEPTRON_PATH)/board/common/post-build.sh $(BR2_EXTERNAL_NEPTRON_PATH)/board/pc/post-build.sh"
BR2_ROOTFS_POST_IMAGE_SCRIPT="$(BR2_EXTERNAL_NEPTRON_PATH)/board/pc/post-image.sh"
BR2_LINUX_KERNEL=y
BR2_LINUX_KERNEL_CUSTOM_VERSION=y
BR2_LINUX_KERNEL_CUSTOM_VERSION_VALUE="6.18.63"
BR2_LINUX_KERNEL_DEFCONFIG="x86_64"
# The 15 kHz patch set of D0023R, pinned; see os/patches/linux/linux.hash.
# LICENCE QUESTION: the LICENSE file of the patch repository says GPL-3.0,
# and the kernel is GPL-2.0 only. The owner has asked the author to clarify.
# No image built with these patches may be distributed until that is
# resolved. `cargo xtask os build --no-kernel-15khz` builds without them.
BR2_LINUX_KERNEL_PATCH="https://raw.githubusercontent.com/D0023R/linux_kernel_15khz/8c96dd9f0b343a6d1ef3c61041783ee106957886/linux-6.18/01_linux_15khz.patch https://raw.githubusercontent.com/D0023R/linux_kernel_15khz/8c96dd9f0b343a6d1ef3c61041783ee106957886/linux-6.18/02_linux_15khz_interlaced_mode_fix.patch https://raw.githubusercontent.com/D0023R/linux_kernel_15khz/8c96dd9f0b343a6d1ef3c61041783ee106957886/linux-6.18/03_linux_15khz_dcn1_dcn2_dcn3_interlaced_mode_fix.patch https://raw.githubusercontent.com/D0023R/linux_kernel_15khz/8c96dd9f0b343a6d1ef3c61041783ee106957886/linux-6.18/04_linux_15khz_dce_interlaced_mode_fix.patch https://raw.githubusercontent.com/D0023R/linux_kernel_15khz/8c96dd9f0b343a6d1ef3c61041783ee106957886/linux-6.18/05_linux_15khz_amdgpu_pll_fix.patch https://raw.githubusercontent.com/D0023R/linux_kernel_15khz/8c96dd9f0b343a6d1ef3c61041783ee106957886/linux-6.18/06_linux_switchres_kms_drm_modesetting.patch https://raw.githubusercontent.com/D0023R/linux_kernel_15khz/8c96dd9f0b343a6d1ef3c61041783ee106957886/linux-6.18/07_linux_15khz_fix_ddc.patch https://raw.githubusercontent.com/D0023R/linux_kernel_15khz/8c96dd9f0b343a6d1ef3c61041783ee106957886/linux-6.18/08_linux_15khz_interlace_force_even.patch https://raw.githubusercontent.com/D0023R/linux_kernel_15khz/8c96dd9f0b343a6d1ef3c61041783ee106957886/linux-6.18/09_linux_15khz_i915_gen9_interlace.patch"
BR2_LINUX_KERNEL_CONFIG_FRAGMENT_FILES="$(BR2_EXTERNAL_NEPTRON_PATH)/board/pc/video.config $(BR2_EXTERNAL_NEPTRON_PATH)/board/pc/console.config $(BR2_EXTERNAL_NEPTRON_PATH)/board/pc/input.config $(BR2_EXTERNAL_NEPTRON_PATH)/board/pc/sound.config $(BR2_EXTERNAL_NEPTRON_PATH)/board/pc/storage.config $(BR2_EXTERNAL_NEPTRON_PATH)/board/pc/network.config $(BR2_EXTERNAL_NEPTRON_PATH)/board/qemu/host.config"
BR2_LINUX_KERNEL_NEEDS_HOST_OPENSSL=y
BR2_LINUX_KERNEL_NEEDS_HOST_LIBELF=y
BR2_TARGET_ROOTFS_EXT2=y
BR2_TARGET_ROOTFS_EXT2_4=y
BR2_TARGET_ROOTFS_EXT2_SIZE="384M"
BR2_TARGET_ROOTFS_EROFS=y
# BR2_TARGET_ROOTFS_TAR is not set
BR2_TARGET_GRUB2=y
BR2_TARGET_GRUB2_I386_PC=y
BR2_TARGET_GRUB2_X86_64_EFI=y
BR2_TARGET_GRUB2_BUILTIN_MODULES_PC="boot linux fat part_msdos normal biosdisk"
BR2_TARGET_GRUB2_BUILTIN_MODULES_EFI="boot linux fat part_msdos normal"
BR2_PACKAGE_HOST_GENIMAGE=y
BR2_PACKAGE_HOST_DOSFSTOOLS=y
BR2_PACKAGE_HOST_MTOOLS=y
BR2_PACKAGE_HOST_EXFATPROGS=y
BR2_PACKAGE_HOST_E2FSPROGS=y
BR2_PACKAGE_E2FSPROGS=y
BR2_PACKAGE_EXFATPROGS=y
BR2_PACKAGE_UTIL_LINUX=y
BR2_PACKAGE_UTIL_LINUX_BINARIES=y
BR2_PACKAGE_UTIL_LINUX_PARTX=y
BR2_PACKAGE_LIBDRM=y
BR2_PACKAGE_NEPTRON_VKMS_PROBE=y
BR2_PACKAGE_NEPTRON_CAPTURE=y
BR2_PACKAGE_LIBRETRO_FCEUMM=y
BR2_PACKAGE_LIBRETRO_SNES9X=y
BR2_PACKAGE_LIBRETRO_GENESIS_PLUS_GX=y
BR2_PACKAGE_MESA3D=y
BR2_PACKAGE_MESA3D_LLVM=y
BR2_PACKAGE_MESA3D_GALLIUM_DRIVER_IRIS=y
BR2_PACKAGE_MESA3D_GALLIUM_DRIVER_LLVMPIPE=y
BR2_PACKAGE_MESA3D_GALLIUM_DRIVER_SOFTPIPE=y
BR2_PACKAGE_MESA3D_OPENGL_EGL=y
BR2_PACKAGE_MESA3D_OPENGL_ES=y
BR2_PACKAGE_ALSA_LIB=y
# amixer only: S08neptron-mixer sets each card's playback controls to
# 0 dB and unmutes them at boot.
BR2_PACKAGE_ALSA_UTILS=y
# BR2_PACKAGE_ALSA_UTILS_ALSACTL is not set
# BR2_PACKAGE_ALSA_UTILS_ALSAMIXER is not set
BR2_PACKAGE_ALSA_UTILS_AMIXER=y
BR2_PACKAGE_SDL3=y
BR2_PACKAGE_SDL3_KMSDRM=y
BR2_PACKAGE_SDL3_OPENGLES=y
BR2_PACKAGE_HOST_RUSTC=y
BR2_PACKAGE_NEPTRON=y
BR2_PACKAGE_NEPTRON_LAUNCH=y
BR2_PACKAGE_NEPTRONCTL=y
# The network share: the user-space part of the kernel SMB server, and the
# mDNS responder that names the PC neptron.local
# (docs/spec/network-share.md). S45neptron-share starts both.
BR2_PACKAGE_KSMBD_TOOLS=y
BR2_PACKAGE_MDNSD=y
```

## os/configs/neptron_qemu_aarch64_defconfig
```kconfig
BR2_aarch64=y
BR2_CCACHE=y
BR2_GLOBAL_PATCH_DIR="$(BR2_EXTERNAL_NEPTRON_PATH)/patches"
BR2_DOWNLOAD_FORCE_CHECK_HASHES=y
BR2_TOOLCHAIN_BUILDROOT_GLIBC=y
BR2_TOOLCHAIN_BUILDROOT_CXX=y
BR2_KERNEL_HEADERS_AS_KERNEL=y
BR2_PACKAGE_HOST_LINUX_HEADERS_CUSTOM_6_18=y
BR2_TARGET_GENERIC_HOSTNAME="neptron"
BR2_TARGET_GENERIC_ISSUE="NEPTRON"
BR2_INIT_BUSYBOX=y
BR2_ROOTFS_DEVICE_CREATION_DYNAMIC_MDEV=y
BR2_PACKAGE_BUSYBOX_CONFIG_FRAGMENT_FILES="$(BR2_EXTERNAL_NEPTRON_PATH)/board/common/busybox.config"
# BR2_TARGET_GENERIC_GETTY is not set
BR2_ROOTFS_OVERLAY="$(BR2_EXTERNAL_NEPTRON_PATH)/board/common/rootfs-overlay $(BR2_EXTERNAL_NEPTRON_PATH)/board/qemu/rootfs-overlay"
BR2_LINUX_KERNEL=y
BR2_LINUX_KERNEL_CUSTOM_VERSION=y
BR2_LINUX_KERNEL_CUSTOM_VERSION_VALUE="6.18.63"
BR2_LINUX_KERNEL_USE_CUSTOM_CONFIG=y
BR2_LINUX_KERNEL_CUSTOM_CONFIG_FILE="board/qemu/aarch64-virt/linux.config"
BR2_LINUX_KERNEL_CONFIG_FRAGMENT_FILES="$(BR2_EXTERNAL_NEPTRON_PATH)/board/qemu/video.config $(BR2_EXTERNAL_NEPTRON_PATH)/board/qemu/input.config $(BR2_EXTERNAL_NEPTRON_PATH)/board/qemu/sound.config $(BR2_EXTERNAL_NEPTRON_PATH)/board/qemu/host.config"
BR2_LINUX_KERNEL_NEEDS_HOST_OPENSSL=y
BR2_TARGET_ROOTFS_EXT2=y
BR2_TARGET_ROOTFS_EXT2_4=y
BR2_TARGET_ROOTFS_EXT2_SIZE="256M"
# BR2_TARGET_ROOTFS_TAR is not set
BR2_PACKAGE_LIBDRM=y
BR2_PACKAGE_LIBDRM_INSTALL_TESTS=y
BR2_PACKAGE_NEPTRON_VKMS_PROBE=y
BR2_PACKAGE_LIBRETRO_FCEUMM=y
BR2_PACKAGE_LIBRETRO_SNES9X=y
BR2_PACKAGE_LIBRETRO_GENESIS_PLUS_GX=y
BR2_PACKAGE_MESA3D=y
BR2_PACKAGE_MESA3D_GALLIUM_DRIVER_SOFTPIPE=y
BR2_PACKAGE_MESA3D_OPENGL_EGL=y
BR2_PACKAGE_MESA3D_OPENGL_ES=y
BR2_PACKAGE_ALSA_LIB=y
BR2_PACKAGE_SDL3=y
BR2_PACKAGE_SDL3_KMSDRM=y
BR2_PACKAGE_SDL3_OPENGLES=y
BR2_PACKAGE_KMSCUBE=y
BR2_PACKAGE_HOST_RUSTC=y
BR2_PACKAGE_NEPTRON=y
BR2_PACKAGE_NEPTRON_LAUNCH=y
BR2_PACKAGE_NEPTRONCTL=y
BR2_PACKAGE_NEPTRON_CAPTURE=y
```

## os/package/libretro-fceumm/Config.in
```kconfig
config BR2_PACKAGE_LIBRETRO_FCEUMM
	bool "libretro-fceumm"
	help
	  FCEUmm, the libretro core for the Nintendo Entertainment
	  System. NEPTRON runs it for the system "nes". Licence:
	  GPL-2.0 or later.

	  https://github.com/libretro/libretro-fceumm
```

## os/package/libretro-genesis-plus-gx/Config.in
```kconfig
config BR2_PACKAGE_LIBRETRO_GENESIS_PLUS_GX
	bool "libretro-genesis-plus-gx"
	help
	  Genesis Plus GX, the libretro core for the Sega Mega Drive.
	  NEPTRON runs it for the system "megadrive". Licence: the
	  Genesis Plus GX licence, which forbids sale and commercial
	  use.

	  https://github.com/libretro/Genesis-Plus-GX
```

## os/package/libretro-snes9x/Config.in
```kconfig
config BR2_PACKAGE_LIBRETRO_SNES9X
	bool "libretro-snes9x"
	depends on BR2_INSTALL_LIBSTDCPP
	help
	  Snes9x, the libretro core for the Super Nintendo
	  Entertainment System. NEPTRON runs it for the system "snes".
	  Licence: the Snes9x licence, for non-commercial use only.

	  https://github.com/libretro/snes9x

comment "libretro-snes9x needs a toolchain w/ C++"
	depends on !BR2_INSTALL_LIBSTDCPP
```

## os/package/neptron-capture/Config.in
```kconfig
config BR2_PACKAGE_NEPTRON_CAPTURE
	bool "neptron-capture"
	depends on BR2_TOOLCHAIN_HAS_THREADS # libdrm
	select BR2_PACKAGE_LIBDRM
	help
	  Waits until the frontend shows a screen, then takes the
	  writeback picture of the display that the launcher holds
	  and prints it. A test tool for vkms in QEMU, for the boot
	  check.
```

## os/package/neptron-launch/Config.in
```kconfig
config BR2_PACKAGE_NEPTRON_LAUNCH
	bool "neptron-launch"
	depends on BR2_PACKAGE_HOST_RUSTC_TARGET_ARCH_SUPPORTS
	select BR2_PACKAGE_HOST_RUSTC
	help
	  The NEPTRON launcher: it holds the DRM device, starts the
	  frontend and starts it again when it ends. Built from this
	  checkout in the release profile.
```

## os/package/neptron-vkms-probe/Config.in
```kconfig
config BR2_PACKAGE_NEPTRON_VKMS_PROBE
	bool "neptron-vkms-probe"
	depends on BR2_TOOLCHAIN_HAS_THREADS # libdrm
	select BR2_PACKAGE_LIBDRM
	help
	  Commits user modelines through the atomic KMS API and reports
	  what the driver does with them: the mode read back, vblank
	  periods, flip events, frame CRCs and the writeback picture.
	  A test tool for the QEMU images and the vkms driver.
```

## os/package/neptron/Config.in
```kconfig
config BR2_PACKAGE_NEPTRON
	bool "neptron"
	depends on BR2_PACKAGE_HOST_RUSTC_TARGET_ARCH_SUPPORTS
	depends on BR2_PACKAGE_MESA3D_OPENGL_EGL
	depends on BR2_PACKAGE_MESA3D_OPENGL_ES
	depends on BR2_PACKAGE_SDL3
	select BR2_PACKAGE_HOST_RUSTC
	select BR2_PACKAGE_LIBDRM
	select BR2_PACKAGE_ALSA_LIB
	help
	  The NEPTRON frontend, with the DRM/KMS backend (Cargo
	  feature kms), built from this checkout in the release
	  profile. Installs the data files that it reads at run time
	  in /usr/share/neptron.

config BR2_PACKAGE_NEPTRON_CONTROL
	bool "control commands"
	depends on BR2_PACKAGE_NEPTRON
	help
	  The Cargo feature control: the commands of the control
	  protocol that change the frontend (input, launch, settings).
	  Only the development variant turns it on.
```

## os/package/neptronctl/Config.in
```kconfig
config BR2_PACKAGE_NEPTRONCTL
	bool "neptronctl"
	depends on BR2_PACKAGE_NEPTRON # data/monitors in /usr/share/neptron
	help
	  The NEPTRON command-line client, with the DRM/KMS self-test
	  (Cargo feature kms), built from this checkout in the release
	  profile. It reads the monitor presets that the frontend
	  package installs in /usr/share/neptron/monitors.
```
