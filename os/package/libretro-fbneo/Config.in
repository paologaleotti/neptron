## os/package/libretro-fbneo/Config.in
```kconfig
config BR2_PACKAGE_LIBRETRO_FBNEO
	bool "libretro-fbneo"
	depends on BR2_INSTALL_LIBSTDCPP
	depends on BR2_TOOLCHAIN_HAS_THREADS
	help
	  FinalBurn Neo, the libretro core for arcade boards: Neo Geo,
	  CPS-1, CPS-2, Cave and many others.
	  Licence: the FB Neo licence, for non-commercial use only, with
	  the MAME licence.

	  https://github.com/libretro/FBNeo

comment "libretro-fbneo needs a toolchain w/ C++, threads"
	depends on !BR2_INSTALL_LIBSTDCPP || !BR2_TOOLCHAIN_HAS_THREADS
```

## os/package/sdl-gamecontrollerdb/Config.in
```kconfig
config BR2_PACKAGE_SDL_GAMECONTROLLERDB
	bool "sdl-gamecontrollerdb"
	help
	  SDL_GameControllerDB, the community database of gamepad
	  mappings for SDL. The frontend loads its Linux lines after
	  the NEPTRON mapping file. Licence: zlib.

	  https://github.com/mdqinc/SDL_GameControllerDB
```
